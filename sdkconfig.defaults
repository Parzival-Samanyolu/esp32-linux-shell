## sdkconfig.defaults
```kconfig
# =============================================================================
# Default sdkconfig for the ESP32 WROVER-E Linux Shell
# PlatformIO applies these on the first build to generate sdkconfig.*
# =============================================================================

# --- PSRAM (8MB external SPI RAM) -------------------------------------------
# ESP-IDF 5.x option name:
CONFIG_SPIRAM=y
# ESP-IDF 4.x compatibility name (harmless if unknown):
CONFIG_ESP32_SPIRAM_SUPPORT=y
CONFIG_SPIRAM_MODE_QUAD=y
CONFIG_SPIRAM_TYPE_AUTO=y
CONFIG_SPIRAM_SPEED_80M=y
CONFIG_SPIRAM_USE_MALLOC=y
# Let heap_caps_malloc(MALLOC_CAP_SPIRAM) hand out PSRAM, and allow the
# allocator to fall back to PSRAM for large internal requests.
CONFIG_SPIRAM_MALLOC_ALWAYSINTERNAL=16384
CONFIG_SPIRAM_TRY_ALLOCATE_WIFI_LWIP=y
CONFIG_SPIRAM_IGNORE_NOTFOUND=y
# Allow placing selected .bss in PSRAM (used by a linker fragment to move the
# pocketpy interpreter's large static data out of scarce internal DRAM).
CONFIG_SPIRAM_ALLOW_BSS_SEG_EXTERNAL_MEMORY=y

# --- FreeRTOS instrumentation (required for a real htop) --------------------
CONFIG_FREERTOS_USE_TRACE_FACILITY=y
CONFIG_FREERTOS_GENERATE_RUN_TIME_STATS=y
CONFIG_FREERTOS_USE_STATS_FORMATTING_FUNCTIONS=y
CONFIG_FREERTOS_VTASKLIST_INCLUDE_COREID=y

# --- Networking / sockets ---------------------------------------------------
# Enough sockets for the listener + a few concurrent shell clients + HTTP.
CONFIG_LWIP_MAX_SOCKETS=16
# Enable raw sockets so the ICMP ping API works.
CONFIG_LWIP_IPV4=y

# --- FATFS: long filenames on the SD card -----------------------------------
CONFIG_FATFS_LFN_HEAP=y
CONFIG_FATFS_MAX_LFN=255

# --- Flash (4MB on the Deneyap WROVER-E) ------------------------------------
CONFIG_ESPTOOLPY_FLASHSIZE_4MB=y
CONFIG_ESPTOOLPY_FLASHSIZE="4MB"
# 80MHz flash — required to unlock 80MHz PSRAM (they share SPI timing).
CONFIG_ESPTOOLPY_FLASHFREQ_80M=y
CONFIG_ESPTOOLPY_FLASHFREQ="80m"

# --- CPU: run the Xtensa cores at full 240MHz -------------------------------
CONFIG_ESP32_DEFAULT_CPU_FREQ_240=y
CONFIG_ESP32_DEFAULT_CPU_FREQ_MHZ=240

# --- Compiler: optimize for performance (-O2) instead of the default -Og -----
# The default debug build runs ~10-20x slower; -O2 lets the chip show its real
# integer/float throughput and speeds up the interpreters and camera pipeline.
CONFIG_COMPILER_OPTIMIZATION_PERF=y

# --- Misc -------------------------------------------------------------------
CONFIG_ESP_MAIN_TASK_STACK_SIZE=8192
CONFIG_ESP_SYSTEM_EVENT_TASK_STACK_SIZE=4096
# Default log level INFO on UART0 (serial), shell traffic is separate.
CONFIG_LOG_DEFAULT_LEVEL_INFO=y
```
